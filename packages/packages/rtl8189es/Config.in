## packages/packages/rtl8189es/Config.in
```kconfig
config BR2_PACKAGE_RTL8189ES
	bool "rtl8189es"
    help
      The Realtek RTL8189ES-VB-CG is a highly integrated single-chip
	  802.11n Wireless LAN network SDIO interface controller.
	  This package provide the kernel module for this chip.
```

## packages/packages/ssh-authorized-keys/Config.in
```kconfig
config BR2_PACKAGE_SSH_AUTH_KEYS
    bool "install public key"
	  depends on BR2_PACKAGE_OPENSSH
    help
      Install public key on target

config BR2_PACKAGE_SSH_AUTH_KEYS_USER
    string "user"
    depends on BR2_PACKAGE_SSH_AUTH_KEYS
    help
      user to install the key

config BR2_PACKAGE_SSH_AUTH_KEYS_PATH
    string "path"
    depends on BR2_PACKAGE_SSH_AUTH_KEYS
    help
      path to the public key
```
