## configs/nanopi_neo_plus2_defconfig
```kconfig
BR2_aarch64=y
BR2_ARM_FPU_VFPV4=y
BR2_PACKAGE_HOST_LINUX_HEADERS_CUSTOM_5_3=y
BR2_TOOLCHAIN_BUILDROOT_LOCALE=y
BR2_TARGET_GENERIC_HOSTNAME="Nanopi"
BR2_TARGET_GENERIC_ISSUE="Welcome to FriendlyARM Nanopi NEO2"
BR2_ROOTFS_DEVICE_CREATION_DYNAMIC_MDEV=y
# BR2_TARGET_ENABLE_ROOT_LOGIN is not set
BR2_SYSTEM_BIN_SH_BASH=y
BR2_ROOTFS_USERS_TABLES="$(TOPDIR)/../configs/users_table.txt"
BR2_ROOTFS_OVERLAY="board/friendlyarm/nanopi-neo-plus2/rootfs_overlay $(TOPDIR)/../overlays/custom"
BR2_ROOTFS_POST_BUILD_SCRIPT="board/friendlyarm/nanopi-neo-plus2/post-build.sh"
BR2_ROOTFS_POST_IMAGE_SCRIPT="support/scripts/genimage.sh"
BR2_ROOTFS_POST_SCRIPT_ARGS="-c board/friendlyarm/nanopi-neo-plus2/genimage.cfg"
BR2_LINUX_KERNEL=y
BR2_LINUX_KERNEL_CUSTOM_VERSION=y
BR2_LINUX_KERNEL_CUSTOM_VERSION_VALUE="5.3.4"
BR2_LINUX_KERNEL_PATCH="$(TOPDIR)/../kernel/kernel-5.3.y"
BR2_LINUX_KERNEL_USE_CUSTOM_CONFIG=y
BR2_LINUX_KERNEL_CUSTOM_CONFIG_FILE="$(TOPDIR)/../configs/linux_defconfig"
BR2_LINUX_KERNEL_CONFIG_FRAGMENT_FILES="board/friendlyarm/nanopi-neo-plus2/linux-extras.config"
BR2_LINUX_KERNEL_DTS_SUPPORT=y
BR2_LINUX_KERNEL_INTREE_DTS_NAME="allwinner/sun50i-h5-nanopi-neo-plus2"
BR2_LINUX_KERNEL_NEEDS_HOST_OPENSSL=y
BR2_PACKAGE_BUSYBOX_CONFIG="$(TOPDIR)/../configs/busybox_configs"
BR2_PACKAGE_BUSYBOX_SHOW_OTHERS=y
BR2_PACKAGE_LINUX_FIRMWARE=y
BR2_PACKAGE_LINUX_FIRMWARE_BRCM_BCM43XXX=y
BR2_PACKAGE_I2C_TOOLS=y
BR2_PACKAGE_RNG_TOOLS=y
BR2_PACKAGE_PYTHON=y
BR2_PACKAGE_LIBNFC=y
# BR2_PACKAGE_LIBNFC_ARYGON is not set
BR2_PACKAGE_LIBNFC_PN532_I2C=y
# BR2_PACKAGE_LIBNFC_PN53X_USB is not set
BR2_PACKAGE_LINUX_PAM=y
BR2_PACKAGE_CRDA=y
BR2_PACKAGE_FAIL2BAN=y
BR2_PACKAGE_HIAWATHA=y
BR2_PACKAGE_HIAWATHA_SSL=y
BR2_PACKAGE_IW=y
BR2_PACKAGE_OPENSSH=y
BR2_PACKAGE_WIRELESS_TOOLS=y
BR2_PACKAGE_WIRELESS_TOOLS_LIB=y
BR2_PACKAGE_WPA_SUPPLICANT=y
BR2_PACKAGE_WPA_SUPPLICANT_CLI=y
BR2_PACKAGE_SUDO=y
BR2_PACKAGE_HTOP=y
BR2_PACKAGE_RSYSLOG=y
BR2_TARGET_ROOTFS_EXT2=y
BR2_TARGET_ROOTFS_EXT2_4=y
BR2_TARGET_ROOTFS_EXT2_SIZE="130M"
BR2_TARGET_ARM_TRUSTED_FIRMWARE=y
BR2_TARGET_ARM_TRUSTED_FIRMWARE_CUSTOM_GIT=y
BR2_TARGET_ARM_TRUSTED_FIRMWARE_CUSTOM_REPO_URL="https://github.com/apritzel/arm-trusted-firmware.git"
BR2_TARGET_ARM_TRUSTED_FIRMWARE_CUSTOM_REPO_VERSION="aa75c8da415158a94b82a430b2b40000778e851f"
BR2_TARGET_ARM_TRUSTED_FIRMWARE_PLATFORM="sun50iw1p1"
BR2_TARGET_UBOOT=y
BR2_TARGET_UBOOT_BUILD_SYSTEM_KCONFIG=y
BR2_TARGET_UBOOT_CUSTOM_VERSION=y
BR2_TARGET_UBOOT_CUSTOM_VERSION_VALUE="2019.10"
BR2_TARGET_UBOOT_BOARD_DEFCONFIG="nanopi_neo_plus2"
BR2_TARGET_UBOOT_NEEDS_DTC=y
BR2_TARGET_UBOOT_NEEDS_PYLIBFDT=y
BR2_TARGET_UBOOT_NEEDS_ATF_BL31=y
BR2_TARGET_UBOOT_FORMAT_CUSTOM=y
BR2_TARGET_UBOOT_FORMAT_CUSTOM_NAME="u-boot.itb"
BR2_TARGET_UBOOT_SPL=y
BR2_TARGET_UBOOT_SPL_NAME="spl/sunxi-spl.bin"
BR2_PACKAGE_HOST_DOSFSTOOLS=y
BR2_PACKAGE_HOST_GENIMAGE=y
BR2_PACKAGE_HOST_MTOOLS=y
```

## configs/nanopi_r1s_defconfig
```kconfig
BR2_aarch64=y
BR2_ARM_FPU_VFPV4=y

BR2_PACKAGE_HOST_LINUX_HEADERS_CUSTOM_4_14=y

# Firmware
BR2_TARGET_ARM_TRUSTED_FIRMWARE=y
BR2_TARGET_ARM_TRUSTED_FIRMWARE_CUSTOM_GIT=y
BR2_TARGET_ARM_TRUSTED_FIRMWARE_CUSTOM_REPO_URL="https://github.com/apritzel/arm-trusted-firmware.git"
BR2_TARGET_ARM_TRUSTED_FIRMWARE_CUSTOM_REPO_VERSION="aa75c8da415158a94b82a430b2b40000778e851f"
BR2_TARGET_ARM_TRUSTED_FIRMWARE_PLATFORM="sun50iw1p1"

# Bootloader
BR2_TARGET_UBOOT=y
BR2_TARGET_UBOOT_BUILD_SYSTEM_KCONFIG=y
BR2_TARGET_UBOOT_CUSTOM_VERSION=y
BR2_TARGET_UBOOT_CUSTOM_VERSION_VALUE="2019.10"
BR2_TARGET_UBOOT_BOARD_DEFCONFIG="nanopi_neo2"
BR2_TARGET_UBOOT_NEEDS_DTC=y
BR2_TARGET_UBOOT_NEEDS_PYLIBFDT=y
BR2_TARGET_UBOOT_NEEDS_ATF_BL31=y
BR2_TARGET_UBOOT_FORMAT_CUSTOM=y
BR2_TARGET_UBOOT_FORMAT_CUSTOM_NAME="u-boot.itb"
BR2_TARGET_UBOOT_SPL=y
BR2_TARGET_UBOOT_SPL_NAME="spl/sunxi-spl.bin"

# Kernel
BR2_LINUX_KERNEL=y
BR2_LINUX_KERNEL_CUSTOM_GIT=y
BR2_LINUX_KERNEL_CUSTOM_REPO_URL="https://github.com/friendlyarm/linux"
BR2_LINUX_KERNEL_CUSTOM_REPO_VERSION="sunxi-4.14.y"
BR2_LINUX_KERNEL_PATCH="$(TOPDIR)/../kernel/kernel-4.14.y"
BR2_LINUX_KERNEL_DTS_SUPPORT=y
BR2_LINUX_KERNEL_INTREE_DTS_NAME="allwinner/sun50i-h5-nanopi-r1s"
BR2_LINUX_KERNEL_NEEDS_HOST_OPENSSL=y

# Filesystem
BR2_ROOTFS_DEVICE_CREATION_DYNAMIC_MDEV=y
BR2_TARGET_ROOTFS_EXT2=y
BR2_TARGET_ROOTFS_EXT2_4=y
BR2_PACKAGE_HOST_DOSFSTOOLS=y
BR2_PACKAGE_HOST_GENIMAGE=y
BR2_PACKAGE_HOST_MTOOLS=y
BR2_TARGET_GENERIC_ISSUE="Welcome to FriendlyARM Nanopi R1S"
BR2_ROOTFS_POST_BUILD_SCRIPT="$(TOPDIR)/../configs/nanopi-r1s/post-build.sh"
BR2_ROOTFS_POST_IMAGE_SCRIPT="support/scripts/genimage.sh"
BR2_ROOTFS_POST_SCRIPT_ARGS="-c $(TOPDIR)/../configs/nanopi-r1s/genimage.cfg"

# System
BR2_TARGET_GENERIC_HOSTNAME="Nanopi"
# BR2_TARGET_ENABLE_ROOT_LOGIN is not set

# Wireless packages
BR2_PACKAGE_CRDA=y
BR2_PACKAGE_IW=y
BR2_PACKAGE_KM_RTL8189ES=y
BR2_PACKAGE_WIRELESS_TOOLS=y
BR2_PACKAGE_WIRELESS_TOOLS_LIB=y
BR2_PACKAGE_WPA_SUPPLICANT=y
BR2_PACKAGE_WPA_SUPPLICANT_CLI=y
```

## packages/Config.in
```kconfig
# config packages
source "$BR2_EXTERNAL_PACKAGES_PATH/packages/config-bash/Config.in"
source "$BR2_EXTERNAL_PACKAGES_PATH/packages/config-dhcpd/Config.in"
source "$BR2_EXTERNAL_PACKAGES_PATH/packages/config-domain-connect-dyndns/Config.in"
source "$BR2_EXTERNAL_PACKAGES_PATH/packages/config-hostapd/Config.in"
source "$BR2_EXTERNAL_PACKAGES_PATH/packages/config-iptables/Config.in"
source "$BR2_EXTERNAL_PACKAGES_PATH/packages/config-lighttpd-php/Config.in"
source "$BR2_EXTERNAL_PACKAGES_PATH/packages/config-mdev/Config.in"
source "$BR2_EXTERNAL_PACKAGES_PATH/packages/config-openssh/Config.in"
source "$BR2_EXTERNAL_PACKAGES_PATH/packages/config-rpi-pitft-28r/Config.in"
source "$BR2_EXTERNAL_PACKAGES_PATH/packages/config-oh-my-zsh/Config.in"
source "$BR2_EXTERNAL_PACKAGES_PATH/packages/config-sudo-pam/Config.in"
source "$BR2_EXTERNAL_PACKAGES_PATH/packages/config-weston-fbdev/Config.in"
source "$BR2_EXTERNAL_PACKAGES_PATH/packages/config-wpa-supplicant/Config.in"

# kernel modules packages
source "$BR2_EXTERNAL_PACKAGES_PATH/packages/km-rtl8189es/Config.in"

# softwares packages
source "$BR2_EXTERNAL_PACKAGES_PATH/packages/oh-my-zsh/Config.in"
source "$BR2_EXTERNAL_PACKAGES_PATH/packages/lnd/Config.in"
source "$BR2_EXTERNAL_PACKAGES_PATH/packages/python-domain-connect/Config.in"
source "$BR2_EXTERNAL_PACKAGES_PATH/packages/python-domain-connect-dyndns/Config.in"
source "$BR2_EXTERNAL_PACKAGES_PATH/packages/python-publicsuffix/Config.in"
source "$BR2_EXTERNAL_PACKAGES_PATH/packages/python-publicsuffixlist/Config.in"
```

## packages/packages/config-dhcpd/Config.in
```kconfig
menu "config-dhcpd"

config BR2_PACKAGE_CONFIG_DHCPD
	bool "basic configuration"
	select BR2_PACKAGE_DHCP
	select BR2_PACKAGE_DHCP_SERVER
	help
	  Basic configuration for dhcpd.

config BR2_PACKAGE_CONFIG_DHCPD_SUBNET
	string "subnet"
	default "10.10.0.0"
	depends on BR2_PACKAGE_CONFIG_DHCPD
	help
	  Subnet.

config BR2_PACKAGE_CONFIG_DHCPD_NETMASK
	string "netmask"
	default "255.255.255.0"
	depends on BR2_PACKAGE_CONFIG_DHCPD
	help
	  Netmask.

config BR2_PACKAGE_CONFIG_DHCPD_RANGE_MIN
	string "range min"
	default "10.10.0.2"
	depends on BR2_PACKAGE_CONFIG_DHCPD
	help
	  Minimum ip address.

config BR2_PACKAGE_CONFIG_DHCPD_RANGE_MAX
	string "range max"
	default "10.10.0.199"
	depends on BR2_PACKAGE_CONFIG_DHCPD
	help
	  Maximum ip address.

config BR2_PACKAGE_CONFIG_DHCPD_DOMAIN_NAME
	string "domain name"
	default "10.10.0.253"
	depends on BR2_PACKAGE_CONFIG_DHCPD
	help
	  Domain name servers.

config BR2_PACKAGE_CONFIG_DHCPD_ROUTERS
	string "routers"
	default "10.10.0.254"
	depends on BR2_PACKAGE_CONFIG_DHCPD
	help
	  Routers.

endmenu
```

## packages/packages/config-domain-connect-dyndns/Config.in
```kconfig
config BR2_PACKAGE_CONFIG_DOMAIN_CONNECT_DYNDNS
	bool "config-domain-connect-dyndns"
	select BR2_PACKAGE_DCRON
	select BR2_PACKAGE_PYTHON_DOMAIN_CONNECT_DYNDNS
	help
	  Basic configuration for domain-connect-dyndns with cron.
```

## packages/packages/config-fstab/Config.in
```kconfig
menu "config-fstab"

config BR2_PACKAGE_CONFIG_FSTAB
	bool "automount disk"
	help
	  Basic configuration to run php with lighttpd.

config BR2_PACKAGE_CONFIG_FSTAB_DEVICE
	string "device"
	default "/dev/sda1"
	depends on BR2_PACKAGE_CONFIG_FSTAB
	help
	  Device in /dev to mount.

config BR2_PACKAGE_CONFIG_FSTAB_MOUNT_POINT
	string "path"
	default "/mnt/sda1"
	depends on BR2_PACKAGE_CONFIG_FSTAB
	help
	  Mounting point..

config BR2_PACKAGE_CONFIG_FSTAB_TYPE
	string "path"
	default "ext4"
	depends on BR2_PACKAGE_CONFIG_FSTAB
	help
	  Type.

endmenu
```

## packages/packages/config-hostapd/Config.in
```kconfig
menu "config-hostapd"

config BR2_PACKAGE_CONFIG_HOSTAPD
	bool "basic configuration"
	select BR2_PACKAGE_BRIDGE_UTILS
	select BR2_PACKAGE_HOSTAPD
	help
	  Basic configuration for hostapd.

config BR2_PACKAGE_CONFIG_HOSTAPD_IFACE
	string "interface name"
	default "wlan0"
	depends on BR2_PACKAGE_CONFIG_HOSTAPD
	help
	  interface name.

config BR2_PACKAGE_CONFIG_HOSTAPD_SSID
	string "ssid"
	default "BuildrootWifi"
	depends on BR2_PACKAGE_CONFIG_HOSTAPD
	help
	  Service Set Identifier.

config BR2_PACKAGE_CONFIG_HOSTAPD_PASSPHRASE
	string "passphrase"
	default "Password2020!"
	depends on BR2_PACKAGE_CONFIG_HOSTAPD
	help
	  Network password.

endmenu
```

## packages/packages/config-iptables/Config.in
```kconfig
menu "config-iptables"

config BR2_PACKAGE_CONFIG_IPTABLES
	bool "basic configuration"
	select BR2_PACKAGE_IPTABLES
	help
	  Block all input/output traffic.

if BR2_PACKAGE_CONFIG_IPTABLES
choice
	prompt "Blocking mode"
	help
	  Block input/output traffic.

config BR2_PACKAGE_CONFIG_IPTABLES_INPUT_OUTPUT
	bool "input/output"
	help
	  Blocking input and output traffic.

config BR2_PACKAGE_CONFIG_IPTABLES_INPUT
	bool "input"
	help
	  Blocking only input traffic.

endchoice
endif

config BR2_PACKAGE_CONFIG_IPTABLES_PORTS
	string "ports"
	default "22 80 443"
	depends on BR2_PACKAGE_CONFIG_IPTABLES
	help
	  Allow some TCP ports, separated by one space.

config BR2_PACKAGE_CONFIG_IPTABLES_ALLOW_PING
	bool "ping"
	default "y"
	depends on BR2_PACKAGE_CONFIG_IPTABLES
	help
	  Allow Ping requests.

config BR2_PACKAGE_CONFIG_IPTABLES_ALLOW_DNS
	bool "dns"
	default "y"
	depends on BR2_PACKAGE_CONFIG_IPTABLES
	help
	  Allow DNS requests.

endmenu
```

## packages/packages/config-lighttpd-php/Config.in
```kconfig
menu "config-lighttpd-php"

config BR2_PACKAGE_CONFIG_LIGHTTPD_PHP
	bool "basic configuration"
	select BR2_PACKAGE_LIGHTTPD
	select BR2_PACKAGE_PHP
	select BR2_PACKAGE_LIGHTTPD_PCRE
	help
	  Basic configuration to run php with lighttpd.

config BR2_PACKAGE_CONFIG_LIGHTTPD_PHP_EXAMPLE
	bool "php example"
	depends on BR2_PACKAGE_CONFIG_LIGHTTPD_PHP
	help
	  Basic php page installed in /var/www/example.

endmenu
```

## packages/packages/config-mdev/Config.in
```kconfig
menu "config-mdev"

config BR2_CONFIG_MDEV
	bool "automount hotplug devices"
	help
	  Auto mount sd/usb devices.

endmenu
```

## packages/packages/config-oh-my-zsh/Config.in
```kconfig
config BR2_CONFIG_OH_MY_ZSH
	bool "config-oh-my-zsh"
	select BR2_PACKAGE_OH_MY_ZSH
	help
	  Configure oh-my-zsh.
```

## packages/packages/config-openssh/Config.in
```kconfig
menu "configuring openssh"

config BR2_CONFIG_OPENSSH
	bool "config-openssh"
	select BR2_PACKAGE_OPENSSH
	help
	  Configure openssh.

config BR2_CONFIG_OPENSSH_INSTALL_KEY
	string "install public key"
	depends on  BR2_CONFIG_OPENSSH
	default "~/.ssh/id_rsa.pub"
	help
	  Install public key on target.

config BR2_CONFIG_OPENSSH_INSTALL_BANNER
	bool "install warning banner"
	depends on  BR2_CONFIG_OPENSSH
	default "y"
	help
	  Install warning banner /etc/banner.txt.

endmenu
```

## packages/packages/config-rpi-pitft-28r/Config.in
```kconfig
menu "config-rpi-pitft-28r"

config BR2_CONFIG_RPI_PITFT_28R
	bool "rpi-pitft-28r"
	help
	  Configure raspberrypi with adafruit pitft 2"8.

endmenu
```

## packages/packages/config-sudo-pam/Config.in
```kconfig
config BR2_CONFIG_SUDO_PAM
	bool "config-sudo-pam"
	depends on (BR2_ENABLE_LOCALE && BR2_USE_WCHAR)
	depends on !BR2_STATIC_LIBS
	depends on BR2_USE_MMU # fork()
	select BR2_PACKAGE_LINUX_PAM
	select BR2_PACKAGE_SUDO
	help
	  Configure sudo with pam.

comment "linux-pam needs a toolchain w/ wchar, locale, dynamic library"
	depends on !(BR2_ENABLE_LOCALE && BR2_USE_WCHAR) \
		|| BR2_STATIC_LIBS
```

## packages/packages/config-weston-fbdev/Config.in
```kconfig
menu "config-weston-fbdev"

config BR2_CONFIG_WESTON_FBDEV
	bool "weston-fbdev"
	select BR2_PACKAHE_WESTON
	select BR2_PACKAGE_WESTON_DEFAULT_FBDEV
	select BR2_PACKAGE_WESTON_FBDEV
	help
	  weston configuration with fbdev.

endmenu
```

## packages/packages/config-wpa-supplicant/Config.in
```kconfig
menu "config-wpa-supplicant"

config BR2_CONFIG_WPA_SUPPLICANT
	bool "config-wpa-supplicant"
	select BR2_PACKAGE_WPA_SUPPLICANT
	help
	  Basic configuration for wpa supplicant.

config BR2_CONFIG_WPA_SUPPLICANT_SSID
	string "ssid"
	depends on BR2_CONFIG_WPA_SUPPLICANT
	help
	  SSID.

config BR2_CONFIG_WPA_SUPPLICANT_PSK
	string "password"
	depends on BR2_CONFIG_WPA_SUPPLICANT
	help
	  Password.

endmenu
```

## packages/packages/km-rtl8189es/Config.in
```kconfig
config BR2_PACKAGE_KM_RTL8189ES
	bool "rtl8189 kernel module"
	depends on BR2_LINUX_KERNEL
	help
	  Kernel module to support rtl8189es.

comment "RTL8189ES module requires a linux kernel to be built"
	depends on !BR2_LINUX_KERNEL
```

## packages/packages/lnd/Config.in
```kconfig
config BR2_PACKAGE_LND
	bool "lnd"
	help
	  Lightning Network Daemon.

	  https://github.com/lightningnetwork/lnd
```

## packages/packages/oh-my-zsh/Config.in
```kconfig
config BR2_PACKAGE_OH_MY_ZSH
	bool "oh-my-zsh"
	select BR2_PACKAGE_ZSH
	help
	  A delightful community-driven framework for
	  managing your zsh configuration.

	  https://ohmyz.sh/
```

## packages/packages/owncloud/Config.in
```kconfig
config BR2_PACKAGE_OWNCLOUD
	bool "owncloud-core"
	# select BR2_PACKAGE_PHP_EXT_PDO
	# select BR2_PACKAGE_PHP_EXT_GD
	# select BR2_PACKAGE_PHP_EXT_SIMPLEXML
	select BR2_PACKAGE_PHP_EXT_SQLITE
	# select BR2_PACKAGE_PHP_EXT_XML
	# select BR2_PACKAGE_PHP_EXT_XMLREADER
	# select BR2_PACKAGE_PHP_EXT_XMLWRITER
	select BR2_PACKAGE_SQLITE
	help
	  ownCloud gives you freedom and control over
	  your own data. A personal cloud which runs
	  on your own server.

	  https://owncloud.org/
```

## packages/packages/python-domain-connect-dyndns/Config.in
```kconfig
config BR2_PACKAGE_PYTHON_DOMAIN_CONNECT_DYNDNS
	bool "python-domain-connect-dyndns"
	select BR2_PACKAGE_PYTHON_DNSPYTHON # runtime
	select BR2_PACKAGE_PYTHON_DOMAIN_CONNECT # runtime
	select BR2_PACKAGE_PYTHON_REQUESTS # runtime
	select BR2_PACKAGE_PYTHON_VALIDATORS # runtime
	help
	  Python client library for Dynamic DNS using Domain Connect.

	  https://github.com/Domain-Connect/DomainConnectDDNS-Python
```

## packages/packages/python-domain-connect/Config.in
```kconfig
config BR2_PACKAGE_PYTHON_DOMAIN_CONNECT
	bool "python-domain-connect"
	select BR2_PACKAGE_PYTHON_CRYPTOGRAPHY # runtime
	select BR2_PACKAGE_PYTHON_DNSPYTHON # runtime
	select BR2_PACKAGE_PYTHON_FUTURE # runtime
	select BR2_PACKAGE_PYTHON_PUBLICSUFFIX # runtime
	select BR2_PACKAGE_PYTHON_PUBLICSUFFIXLIST # runtime
	select BR2_PACKAGE_PYTHON_SIX # runtime
	help
	  Python client library for Domain Connect protocol. See:
	  https://domainconnect.org.

	  https://github.com/Domain-Connect/domainconnect_python
```

## packages/packages/python-publicsuffix/Config.in
```kconfig
config BR2_PACKAGE_PYTHON_PUBLICSUFFIX
	bool "python-publicsuffix"
	help
	  Get a public suffix for a domain name using the Public
	  Suffix List.

	  
```

## packages/packages/python-publicsuffixlist/Config.in
```kconfig
config BR2_PACKAGE_PYTHON_PUBLICSUFFIXLIST
	bool "python-publicsuffixlist"
	help
	  publicsuffixlist implement.

	  https://github.com/ko-zu/psl
```
